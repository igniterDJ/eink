## firmware/main/Kconfig.projbuild
```kconfig
menu "EPD Pin Configuration"

config EPD_PIN_MOSI
    int "MOSI (DIN) GPIO"
    default 9
    range 0 48
    help
        SPI MOSI (DIN) pin for the e-Paper display.

config EPD_PIN_SCLK
    int "SCLK (CLK) GPIO"
    default 8
    range 0 48
    help
        SPI SCLK (CLK) pin for the e-Paper display.

config EPD_PIN_CS
    int "CS GPIO"
    default 7
    range 0 48
    help
        SPI CS (chip select) pin for the e-Paper display.

config EPD_PIN_DC
    int "DC (data/command) GPIO"
    default 5
    range 0 48
    help
        DC (data/command) pin for the e-Paper display.

config EPD_PIN_RST
    int "RST (reset) GPIO"
    default 4
    range 0 48
    help
        RST (reset) pin for the e-Paper display.

config EPD_PIN_BUSY
    int "BUSY GPIO"
    default 6
    range 0 48
    help
        BUSY pin for the e-Paper display. Active HIGH.

endmenu
```

## firmware/sdkconfig.defaults
```kconfig
# ESP32-S3 target
CONFIG_IDF_TARGET="esp32s3"

# Bluetooth
CONFIG_BT_ENABLED=y
CONFIG_BT_NIMBLE_ENABLED=y
CONFIG_BT_NIMBLE_ROLE_PERIPHERAL=y
CONFIG_BT_NIMBLE_MAX_CONNECTIONS=1
CONFIG_BT_NIMBLE_MAX_BONDS=0
CONFIG_BT_NIMBLE_SVC_GAP_DEVICE_NAME="EPD-Keychain"

# BLE only — disable classic BT
CONFIG_BTDM_CTRL_MODE_BLE_ONLY=y
CONFIG_BT_BLE_ONLY=y
CONFIG_BT_BLUEDROID_ENABLED=n

# NimBLE settings
CONFIG_BT_NIMBLE_ATT_PREFERRED_MTU=247
CONFIG_BT_NIMBLE_GATT_MAX_PROCS=8
CONFIG_BT_NIMBLE_MSYS1_BLOCK_COUNT=16
CONFIG_BT_NIMBLE_SVC_GAP_APPEARANCE=0

# SPI
CONFIG_SPI_MASTER_IN_IRAM=n

# NVS
CONFIG_NVS_ENCRYPTION=n

# FreeRTOS
CONFIG_FREERTOS_HZ=1000

# Heap/task sizing
CONFIG_ESP_MAIN_TASK_STACK_SIZE=8192
CONFIG_FREERTOS_TIMER_TASK_STACK_DEPTH=4096

# Log level
CONFIG_LOG_DEFAULT_LEVEL_INFO=y
CONFIG_LOG_MAXIMUM_LEVEL_INFO=y
```
